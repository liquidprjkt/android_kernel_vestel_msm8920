/*
 * Copyright (c) 2021, The teos-dev Team. All rights reserved.
 *
 * This program is free software; you can redistribute it and/or modify
 * it under the terms of the GNU General Public License version 2 and
 * only version 2 as published by the Free Software Foundation.
 *
 * This program is distributed in the hope that it will be useful,
 * but WITHOUT ANY WARRANTY; without even the implied warranty of
 * MERCHANTABILITY or FITNESS FOR A PARTICULAR PURPOSE.  See the
 * GNU General Public License for more details.
 */

/dts-v1/;

#include "msm8920-teos.dtsi"

/ {
	model = "Qualcomm Technologies, Inc. MSM8920-PMI8950 MTP TEOS";
	compatible = "qcom,msm8920-mtp", "qcom,msm8920", "qcom,mtp", "qcom,msm8920-pmi8950-mtp-teos";
	qcom,board-id = <0x580008 0xd0>;
	qcom,pmic-id = <0x10019 0x010011 0x0 0x0>;
};
